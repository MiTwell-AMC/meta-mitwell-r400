## conf/layer.conf
```bitbake
# We have a conf and classes directory, add to BBPATH
BBPATH .= ":${LAYERDIR}"

# We have recipes-* directories, add to BBFILES
BBFILES += "${LAYERDIR}/recipes-*/*/*.bb \
            ${LAYERDIR}/recipes-*/*/*.bbappend"

BBFILE_COLLECTIONS += "mitwell-bsp-layer"
BBFILE_PATTERN_mitwell-bsp-layer = "^${LAYERDIR}/"
BBFILE_PRIORITY_mitwell-bsp-layer = "10"

LAYERDEPENDS_mitwell-bsp-layer = "core"
LAYERSERIES_COMPAT_mitwell-bsp-layer = "zeus hardknott"

BBLAYERS_LAYERINDEX_NAME_mitwell-bsp-layer = "mitwell-osm-imx8mp"
```
